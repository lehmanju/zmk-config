## boards/shields/corne-xiao/Kconfig.defconfig
```kconfig
if SHIELD_CORNE_XIAO_LEFT

# Name has to be fewer than 16 characters long
config ZMK_KEYBOARD_NAME
    default "Corne"

config ZMK_SPLIT_ROLE_CENTRAL
    default y

endif

if SHIELD_CORNE_XIAO_LEFT || SHIELD_CORNE_XIAO_RIGHT

config ZMK_SPLIT
    default y

endif
```

## boards/shields/corne/Kconfig.defconfig
```kconfig
if SHIELD_CORNE_LEFT

# Name has to be fewer than 16 characters long
config ZMK_KEYBOARD_NAME
    default "Corne"

config ZMK_SPLIT_ROLE_CENTRAL
    default y

endif

if SHIELD_CORNE_LEFT || SHIELD_CORNE_RIGHT

config ZMK_SPLIT
    default y

endif
```
